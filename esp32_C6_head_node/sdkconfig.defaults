## esp32_C6_head_node/sdkconfig.defaults
```kconfig
CONFIG_BT_ENABLED=y
# CONFIG_BT_BLUEDROID_ENABLED is not set
CONFIG_BT_NIMBLE_ENABLED=y

CONFIG_PARTITION_TABLE_CUSTOM=y
# CONFIG_PARTITION_TABLE_SINGLE_APP is not set
# CONFIG_PARTITION_TABLE_SINGLE_APP_LARGE is not set
# CONFIG_PARTITION_TABLE_TWO_OTA is not set
# CONFIG_PARTITION_TABLE_TWO_OTA_LARGE is not set
CONFIG_PARTITION_TABLE_CUSTOM_FILENAME="partitions.csv"
CONFIG_PARTITION_TABLE_FILENAME="partitions.csv"
CONFIG_PARTITION_TABLE_OFFSET=0x8000
CONFIG_PARTITION_TABLE_MD5=y
# CONFIG_ESPTOOLPY_FLASHSIZE_1MB is not set
# CONFIG_ESPTOOLPY_FLASHSIZE_2MB is not set
# CONFIG_ESPTOOLPY_FLASHSIZE_4MB is not set
CONFIG_ESPTOOLPY_FLASHSIZE_8MB=y
# CONFIG_ESPTOOLPY_FLASHSIZE_16MB is not set
CONFIG_ESPTOOLPY_FLASHSIZE="8MB"
CONFIG_LV_FONT_DEFAULT_MONTSERRAT_20=y
CONFIG_LV_FONT_MONTSERRAT_14=y
CONFIG_LV_FONT_MONTSERRAT_20=y
CONFIG_LV_FONT_MONTSERRAT_48=y
```

## esp32_logic_analyzer/sdkconfig.defaults
```kconfig
CONFIG_ANALYZER_USE_I2S_CHANNEL_0=y
CONFIG_ANALYZER_SEPARATE_MODE=y
CONFIG_ANALYZER_USE_WS=y
CONFIG_ANALYZER_START_WS_SERVER=y
CONFIG_ANALYZER_WIFI_CONNECT=y
CONFIG_ANALYZER_WIFI_SSID="ITPod"
CONFIG_ANALYZER_WIFI_PASS="zxcxzzxc"
CONFIG_HTTPD_WS_SUPPORT=y
# CONFIG_ANALYZER_USE_SUMP is not set
# CONFIG_ANALYZER_USE_CLI is not set
# CONFIG_ANALYZER_USE_UART is not set
CONFIG_ANALYZER_USE_PORT_ASSIGN=y
CONFIG_ANALYZER_CHAN_0=12
CONFIG_ANALYZER_CHAN_1=14
CONFIG_ANALYZER_CHAN_2=27
CONFIG_ANALYZER_CHAN_3=26
CONFIG_ANALYZER_CHAN_4=25
CONFIG_ANALYZER_CHAN_5=33
CONFIG_ANALYZER_CHAN_6=32
CONFIG_ANALYZER_CHAN_7=35
CONFIG_ANALYZER_CHAN_8=34
CONFIG_ANALYZER_CHAN_9=-1
CONFIG_ANALYZER_CHAN_10=-1
CONFIG_ANALYZER_CHAN_11=-1
CONFIG_ANALYZER_CHAN_12=-1
CONFIG_ANALYZER_CHAN_13=-1
CONFIG_ANALYZER_CHAN_14=-1
CONFIG_ANALYZER_CHAN_15=-1
CONFIG_ANALYZER_TRIG_PIN=-1
CONFIG_ANALYZER_TRIG_EDGE=1
CONFIG_ANALYZER_SAMPLES_COUNT=20000
CONFIG_ANALYZER_SAMPLE_RATE=2000000
CONFIG_ANALYZER_TIMEOUT=5
CONFIG_ANALYZER_CHANNELS=16
CONFIG_ANALYZER_PSRAM=0
```
